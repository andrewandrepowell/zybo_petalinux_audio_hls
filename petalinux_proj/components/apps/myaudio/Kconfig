## petalinux_proj/components/apps/myaudio2/Kconfig
```kconfig
###############################################################################
# Please modify this file if you want to configure your own application.
# You can uncommon and/or change the following Kconfig elements.
###############################################################################


if ROOTFS_COMPONENT_APPS_NAME_MYAUDIO2
	config APPS_MYAUDIO2
		bool
		default y
		select ROOTFS_PACKAGES_LIBSTDCPLUSPLUS6
	comment "No additional options for MYAUDIO2"

# 	config APPS_MYAUDIO2_OPTION0
#	bool "option0"
#	help
#	  Help text
endif
```

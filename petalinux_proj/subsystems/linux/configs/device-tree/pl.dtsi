/*
 * CAUTION: This file is automatically generated by Xilinx.
 * Version: HSI 2016.2
 * Today is: Sun Aug  7 18:18:20 2016
*/


/ {
	amba_pl: amba_pl {
		#address-cells = <1>;
		#size-cells = <1>;
		compatible = "simple-bus";
		ranges ;
		axi_i2s_adi_0: axi_i2s_adi@43c00000 {
			compatible = "xlnx,axi-i2s-adi-1.0";
			reg = <0x43c00000 0x10000>;
			xlnx,bclk-pol = <0x0>;
			xlnx,dma-type = <0x1>;
			xlnx,has-rx = <0x1>;
			xlnx,has-tx = <0x1>;
			xlnx,lrclk-pol = <0x0>;
			xlnx,num-ch = <0x1>;
			xlnx,slot-width = <0x18>;
		};
		fir_0: fir@83c00000 {
			compatible = "xlnx,fir-1.0";
			interrupt-parent = <&intc>;
			interrupts = <0 29 4>;
			reg = <0x83c00000 0x10000>;
			xlnx,s-axi-bus-a-addr-width = <0x5>;
			xlnx,s-axi-bus-a-data-width = <0x20>;
		};
	};
};
